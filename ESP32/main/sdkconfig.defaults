## ESP32/main/sdkconfig.defaults
```kconfig
# 增加系统事件任务栈大小，防止栈溢出
CONFIG_SYSTEM_EVENT_TASK_STACK_SIZE=8192

# 可选：增加主任务栈大小
CONFIG_ESP_MAIN_TASK_STACK_SIZE=8192

# 可选：增加 WiFi 相关任务的栈
CONFIG_ESP_WIFI_TASK_STACK_SIZE=4096
```
